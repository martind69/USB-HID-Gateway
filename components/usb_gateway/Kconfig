## sdkconfig.defaults
```kconfig
# =============================================================================
# Target, Flash & Console
# =============================================================================
CONFIG_IDF_TARGET="esp32p4"
CONFIG_ESPTOOLPY_FLASHSIZE_16MB=y
CONFIG_ESP_CONSOLE_USB_SERIAL_JTAG=n
CONFIG_ESP_CONSOLE_UART_DEFAULT=y
# 32 MB PSRAM (ESP32-P4NRW32 on Waveshare ESP32-P4-Module)
CONFIG_SPIRAM=y
CONFIG_SPIRAM_USE_MALLOC=y
# FreeRTOS tick rate (1 ms resolution)
CONFIG_FREERTOS_HZ=1000
# =============================================================================
# USB Device (TinyUSB on Full-Speed USB1P1 / H2) & USB Host (High-Speed Hub)
# =============================================================================
# Number of TinyUSB HID instances = maximum HID interfaces of the device
# mirrored on USB1P1 (G502 HERO: 2). Minimum 2, enforced by usb_mirror_device.c
CONFIG_TINYUSB_HID_COUNT=2
CONFIG_TINYUSB_CDC_COUNT=0
CONFIG_TINYUSB_MSC_COUNT=0
CONFIG_TINYUSB_MIDI_COUNT=0
CONFIG_TINYUSB_AUDIO_COUNT=0
CONFIG_TINYUSB_VENDOR_COUNT=0
CONFIG_TINYUSB_NET_MODE_NONE=y
# Root port (P4 OTG -> onboard CH334F hub)
CONFIG_USB_HOST_DEBOUNCE_DELAY_MS=250
CONFIG_USB_HOST_RESET_HOLD_MS=30
CONFIG_USB_HOST_RESET_RECOVERY_MS=30
CONFIG_USB_HOST_SET_ADDR_RECOVERY_MS=10
CONFIG_USB_HOST_RESUME_HOLD_MS=30
CONFIG_USB_HOST_RESUME_RECOVERY_MS=20
CONFIG_USB_HOST_SUSPEND_ENTRY_MS=20
# Downstream ports (USB-A 1..3 behind the hub)
CONFIG_USB_HOST_EXT_PORT_RESET_RECOVERY_DELAY_MS=500
CONFIG_USB_HOST_EXT_PORT_CUSTOM_POWER_ON_DELAY_ENABLE=y
CONFIG_USB_HOST_EXT_PORT_CUSTOM_POWER_ON_DELAY_MS=200
# Enable support for the onboard CH334F USB hub + external downstream hubs
CONFIG_USB_HOST_HUBS_SUPPORTED=y
CONFIG_USB_HOST_HUB_MULTI_LEVEL=y
# =============================================================================
# Unused Network & Radio Functions
# =============================================================================
# Onboard ESP32-C6 wireless coprocessor is isolated and unused
# Note: Do NOT set CONFIG_ETH_USE_ESP32_EMAC=n or CONFIG_ETH_USE_OPENETH=n on P4
# (causes esp_eth_clock.c build failure)
CONFIG_LWIP_PPP_SUPPORT=n
CONFIG_ESP_MODEM_ENABLE=n
CONFIG_OPENTHREAD_ENABLED=n
# =============================================================================
# FAT Filesystem (Flash + SDMMC)
# =============================================================================
CONFIG_FATFS_VOLUME_COUNT=2
CONFIG_FATFS_SECTOR_4096=y
CONFIG_FATFS_LFN_HEAP=y
CONFIG_FATFS_MAX_LFN=255
CONFIG_FATFS_CODEPAGE_437=y
CONFIG_FATFS_API_ENCODING_ANSI_OEM=y
CONFIG_FATFS_FS_LOCK=8
CONFIG_FATFS_TIMEOUT_MS=10000
CONFIG_FATFS_PER_FILE_CACHE=y
CONFIG_FATFS_ALLOC_PREFER_ALIGNED_WORK_BUFFERS=y
CONFIG_FATFS_USE_STRFUNC_NONE=y
CONFIG_FATFS_LINK_LOCK=y
CONFIG_FATFS_RENAME_OVERWRITE=y
CONFIG_FATFS_RENAME_REJECT_SUBTREE=y
CONFIG_FATFS_USE_DYN_BUFFERS=y
# =============================================================================
# Application: USB Gateway Hardware & Pin Mapping
# =============================================================================
CONFIG_USB_GATEWAY_ADS7128_ENABLE=y
CONFIG_USB_GATEWAY_DAC7578_ENABLE=y
CONFIG_USB_GATEWAY_SIMULATE_ENABLE=y
CONFIG_USB_GATEWAY_STATUS_LEDS_ENABLE=y
CONFIG_USB_GATEWAY_SSD1306_ENABLE=y
# Analog I2C bus (ADS7128 + DAC7578)
CONFIG_USB_GATEWAY_ANALOG_I2C_SDA=33
CONFIG_USB_GATEWAY_ANALOG_I2C_SCL=32
CONFIG_USB_GATEWAY_ANALOG_I2C_FREQ_HZ=1000000
CONFIG_USB_GATEWAY_ANALOG_REFERENCE_MV=3300
CONFIG_USB_GATEWAY_ADC_SERIES_RESISTOR_OHM=68000
CONFIG_USB_GATEWAY_ADC_CEXT_PF=0
# Analog measurement statistics
CONFIG_USB_GATEWAY_MEASURE_STATIC_SETTLE_MS=10
CONFIG_USB_GATEWAY_MEASURE_STATIC_SAMPLES=256
CONFIG_USB_GATEWAY_MEASURE_ALIGN_DURATION_MS=5000
CONFIG_USB_GATEWAY_MEASURE_ALIGN_MAX_US=12000
CONFIG_USB_GATEWAY_MEASURE_ALIGN_STEP_US=250
CONFIG_USB_GATEWAY_MEASURE_JUMP_EXCLUDE_CODES=1024
CONFIG_USB_GATEWAY_MEASURE_ZOH_MAX_US=3000
CONFIG_USB_GATEWAY_MEASURE_ALIGN_MIN_SAMPLES=250
CONFIG_USB_GATEWAY_MEASURE_DYNAMIC_MIN_SAMPLES=1000
# Report intercept (M7): mapped usages removed from mirrored reports in GENERATE
CONFIG_USB_GATEWAY_INTERCEPT_ENABLE=y
# SPI link to ESP32-S3
CONFIG_USB_GATEWAY_S3_SPI_SCLK_GPIO=6
CONFIG_USB_GATEWAY_S3_SPI_MOSI_GPIO=7
CONFIG_USB_GATEWAY_S3_SPI_MISO_GPIO=8
CONFIG_USB_GATEWAY_S3_SPI_CS_GPIO=23
CONFIG_USB_GATEWAY_S3_SPI_HZ=10000000
CONFIG_USB_GATEWAY_S3_REARM_GUARD_US=500
# SDMMC (1-bit mode)
CONFIG_USB_GATEWAY_SDMMC_CLK_GPIO=43
CONFIG_USB_GATEWAY_SDMMC_CMD_GPIO=44
CONFIG_USB_GATEWAY_SDMMC_D0_GPIO=39
CONFIG_USB_GATEWAY_SDMMC_CD_GPIO=41
CONFIG_USB_GATEWAY_SDMMC_FREQ_KHZ=10000
# OLED Display (SSD1306 SPI)
CONFIG_USB_GATEWAY_SSD1306_REFRESH_MS=200
CONFIG_USB_GATEWAY_SSD1306_SCLK_GPIO=20
CONFIG_USB_GATEWAY_SSD1306_MOSI_GPIO=21
CONFIG_USB_GATEWAY_SSD1306_CS_GPIO=5
CONFIG_USB_GATEWAY_SSD1306_DC_GPIO=4
CONFIG_USB_GATEWAY_SSD1306_RESET_GPIO=22
CONFIG_USB_GATEWAY_SSD1306_SPI_HZ=10000000
# =============================================================================
# Application: Profile Export
# =============================================================================
CONFIG_USB_GATEWAY_PROFILE_EXPORT_HOTKEY_ENABLE=y
CONFIG_USB_GATEWAY_PROFILE_EXPORT_HID_USAGE=0x45
CONFIG_USB_GATEWAY_PROFILE_EXPORT_MODIFIER_MASK=0x05
# =============================================================================
# Application: Capture & Diagnostics
# =============================================================================
CONFIG_USB_GATEWAY_CAPTURE_ENABLE=y
CONFIG_USB_GATEWAY_CAPTURE_DIAG_PERIOD_S=5
CONFIG_USB_GATEWAY_CAPTURE_LEVEL_SD=y
CONFIG_USB_GATEWAY_CAPTURE_SD_DURATION_S=300
# =============================================================================
# Application: OTA Functions
# =============================================================================
CONFIG_USB_GATEWAY_S3_OTA_ENABLE=y
CONFIG_USB_GATEWAY_S3_OTA_IMAGE_PATH="/sdcard/firmware/secondary_s3.bin"
CONFIG_USB_GATEWAY_S3_OTA_VERSION_PATH="/sdcard/firmware/secondary_s3.version"
CONFIG_USB_GATEWAY_S3_OTA_TRIGGER_PATH="/sdcard/firmware/secondary_s3.update"
CONFIG_USB_GATEWAY_S3_OTA_DONE_PATH="/sdcard/firmware/secondary_s3.done"
```

## sdkconfig.defaults.verbose
```kconfig
CONFIG_USB_GATEWAY_CAPTURE_ENABLE=y
CONFIG_USB_GATEWAY_CAPTURE_DIAG_PERIOD_S=5
CONFIG_USB_GATEWAY_CAPTURE_LEVEL_SD=y
CONFIG_USB_GATEWAY_CAPTURE_SD_DURATION_S=600
CONFIG_USB_GATEWAY_CAPTURE_SD_MAX_TOTAL_MIB=256
CONFIG_USB_GATEWAY_CAPTURE_SD_FILE_MIB=8
CONFIG_USB_GATEWAY_CAPTURE_SD_FLUSH_MS=1000
CONFIG_USB_GATEWAY_CAPTURE_SD_QUEUE_DEPTH=512
CONFIG_LOG_DEFAULT_LEVEL_DEBUG=y
```
